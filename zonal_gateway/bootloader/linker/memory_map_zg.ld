
/* Placeholder memory map. Replace with TC375 specific segments */
MEMORY { FLASH (rx) : ORIGIN = 0xA0000000, LENGTH = 1024K
         SRAM  (rwx): ORIGIN = 0x70000000, LENGTH = 192K }
SECTIONS { /* ... */ }

